## conf/layer.conf
```bitbake
BBPATH .= ":${LAYERDIR}"
BBFILES += "${LAYERDIR}/recipes-*/*/*.bb "
BBFILES += "${LAYERDIR}/recipes-*/*/*.bbappend "
BBFILES += "${LAYERDIR}/recipes-*/*.bb "
BBFILES += "${LAYERDIR}/recipes-*/*.bbappend "

BBFILE_COLLECTIONS += "opendash"
BBFILE_PATTERN_opendash = "^${LAYERDIR}/"
BBFILE_PRIORITY_opendash = "6"

LICENSE_FLAGS_ACCEPTED += "commercial"

DISTRO_FEATURES:append = " pi-bluetooth bluez5 bluetooth"
DISTRO_FEATURES:append = " opengl"
DISTRO_FEATURES:append = " x11"
DISTRO_FEATURES:append = " pulseaudio alsa"

PACKAGECONFIG:append:pn-qtconnectivity = " bluez"
PACKAGECONFIG:append:pn-qtbase = " xcb gles2"
PACKAGECONFIG:append:pn-mesa = " gallium vc4 v3d gbm egl dri3"
PACKAGECONFIG:append:pn-alsa-plugins = " pulseaudio"

MACHINE_FEATURES +=" vc4graphics"
CONFIG_DRM="y"
CONFIG_DRM_VC4="y"
CONFIG_DRM_V3D="y"
CONFIG_DRM_KMS_HELPER="y"
CONFIG_DRM_RENDER="y"

KERNEL_MODULE_AUTOLOAD += "v3d"
KERNEL_MODULE_AUTOLOAD += "pulseaudio"


CONFIG_SND="m"
CONFIG_SND_TIMER="m"
CONFIG_SND_PCM="m"
CONFIG_SND_SOC="m"

GPU_MEM = "128"

RPI_EXTRA_CONFIG:append = " dtparam=audio=on"

LAYERSERIES_COMPAT_opendash = "walnascar"
```
